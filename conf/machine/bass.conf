## conf/machine/bass.conf
```bitbake
#@TYPE: Machine
#@NAME: LG Watch Urbane
#@DESCRIPTION: Machine configuration for the LG Watch Urbane

require conf/machine/include/tune-cortexa7.inc

DISTRO_FEATURES += " wifi"
PACKAGECONFIG_append_pn-connman = " wifi"

MACHINE_FEATURES = "apm alsa bluetooth usbgadget usbhost vfat ext2 wifi"
MACHINE_DISPLAY_WIDTH_PIXELS = "320"
MACHINE_DISPLAY_HEIGHT_PIXELS = "320"
MACHINE_DISPLAY_ORIENTATION = "0"
MACHINE_DISPLAY_PPI = "245"
MACHINE_DISPLAY_ROUND = "true"

PREFERRED_PROVIDER_virtual/egl ?= "libhybris"
PREFERRED_PROVIDER_virtual/libgles1 ?= "libhybris"
PREFERRED_PROVIDER_virtual/libgles2 ?= "libhybris"

PREFERRED_PROVIDER_virtual/android-headers = "android"
PREFERRED_PROVIDER_virtual/android-system-image = "android"
PREFERRED_PROVIDER_virtual/kernel = "linux-bass"
PREFERRED_VERSION_android = "lollipop"
PREFERRED_VERSION_linux = "3.10+lollipop"

KERNEL_IMAGETYPE = "zImage-dtb"
IMAGE_FSTYPES += "ext2"

ANDROID_BOARD_SYSTEMIMAGE_PARTITION = "mmcblk0p15"
ANDROID_BOARD_SYSTEMIMAGE_PARTITION_SIZE = "1073741824"
ANDROID_BOARD_FLASH_BLOCK_SIZE = "131072"

IMAGE_INSTALL += "android-tools android-system connman-client msm-fb-refresher brcm-patchram-plus iproute2 wpa-supplicant"
```

## conf/machine/nemo.conf
```bitbake
#@TYPE: Machine
#@NAME: LG Watch Urbane 2 LTE
#@DESCRIPTION: Machine configuration for the LG Watch Urbane 2 LTE

require conf/machine/include/tune-cortexa7.inc
MACHINE_FEATURES = "apm alsa bluetooth usbgadget usbhost vfat ext2"
MACHINE_DISPLAY_ROUND = "true"

PREFERRED_PROVIDER_virtual/egl ?= "libhybris"
PREFERRED_PROVIDER_virtual/libgles1 ?= "libhybris"
PREFERRED_PROVIDER_virtual/libgles2 ?= "libhybris"

PREFERRED_PROVIDER_virtual/android-headers = "android"
PREFERRED_PROVIDER_virtual/android-system-image = "android"
PREFERRED_VERSION_android = "marshmallow"

PREFERRED_PROVIDER_virtual/kernel = "linux-nemo"
PREFERRED_VERSION_linux = "3.10+marshmallow"

KERNEL_IMAGETYPE = "zImage-dtb"
IMAGE_FSTYPES += "ext2"

IMAGE_INSTALL += "android-tools android-system msm-fb-refresher brcm-patchram-plus iproute2 wpa-supplicant"
```
